## boards/shields/floddius/Kconfig.defconfig
```kconfig
if SHIELD_FLODDIUS_LEFT

  config ZMK_KEYBOARD_NAME
    default "floddius"

  config ZMK_SPLIT_ROLE_CENTRAL
    default y

endif

if SHIELD_FLODDIUS_LEFT || SHIELD_FLODDIUS_RIGHT

  config ZMK_SPLIT
    default y

endif
  
```

## boards/shields/floddius/Kconfig.shield
```kconfig
config SHIELD_FLODDIUS_LEFT
  def_bool $(shields_list_contains,floddius_left)

config SHIELD_FLODDIUS_RIGHT
  def_bool $(shields_list_contains,floddius_right)
```
